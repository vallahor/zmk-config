## config/west.yml
```yaml
manifest:
  remotes:
    - name: zmkfirmware
      url-base: https://github.com/zmkfirmware

    - name: vallahor
      url-base: https://github.com/vallahor

  projects:
    - name: zmk
      remote: zmkfirmware
      #revision: main
      revision: v0.3
      import: app/west.yml

    - name: zmk-repeat-hold-module
      remote: vallahor
      revision: main

  self:
    path: config
```
