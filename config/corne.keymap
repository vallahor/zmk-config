/*
 * Copyright (c) 2020 The ZMK Contributors
 *
 * SPDX-License-Identifier: MIT
 */

/* The Decatyl uses only the Corne's inner five columns on each half. */
/ {
    chosen {
        zmk,physical-layout = &foostan_corne_5col_layout;
    };
};

#include "shared_36key.dtsi"
